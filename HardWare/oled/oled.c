#include "oled.h"
const unsigned char F8X16[]=
{	//每行的ascii码相差1，如何得到每行的起始元素下标，只需要将每行字符的ascii减去32再*16即可得到
  0x00,0x00,0x00,0x00,0x00,0x00,0x00,0x00,0x00,0x00,0x00,0x00,0x00,0x00,0x00,0x00,// 0(空格)ascii码是32
  0x00,0x00,0x00,0xF8,0x00,0x00,0x00,0x00,0x00,0x00,0x00,0x33,0x30,0x00,0x00,0x00,//!1
  0x00,0x10,0x0C,0x06,0x10,0x0C,0x06,0x00,0x00,0x00,0x00,0x00,0x00,0x00,0x00,0x00,//"2
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  0x00,0x06,0x01,0x01,0x02,0x02,0x04,0x04,0x00,0x00,0x00,0x00,0x00,0x00,0x00,0x00,//~94
};

void WriteOLedCmd(u8 cmd)
{
	IIC_start();
	
	IIC_Send_byte(0x78);  //设备地址0111 1000
	IIC_Receive_Ack();
	
	IIC_Send_byte(0x00);  //字地址
	IIC_Receive_Ack();
	
	IIC_Send_byte(cmd);
	IIC_Receive_Ack();
	
	IIC_stop();
//	delay_ms(10);
}

void WriteOLedData(u8 data)
{
	IIC_start();
	
	IIC_Send_byte(0x78);  //设备地址0111 1000
	IIC_Receive_Ack();
	
	IIC_Send_byte(0x40);  //字地址
	IIC_Receive_Ack();
	
	IIC_Send_byte(data);
	IIC_Receive_Ack();
	
	IIC_stop();
//	delay_ms(10);
}

void OLED_Set_Position(u8 x, u8 y)
{
	WriteOLedCmd(0xb0 + y);  //确定行
	WriteOLedCmd(((x & 0xf0)>>4) | 0x10); //确定列高位是 0x10
	WriteOLedCmd((x & 0x0f) | 0x00);  //确定列低位是0x00
}

void OLed_Fill(u8 data)
{
	u8 i,j;
	for(i = 0;i < 8;i++)
	{
		OLED_Set_Position(0,i);
		for(j = 0;j < 128;j++)
			WriteOLedData(data);
	}
}

//初始化OLED的驱动SSD1306
void oled_init(void)
{
		IIC_init();
	//给OLED发送命令 初始化OLED
		WriteOLedCmd(0xAE);//--turn off oled panel关闭显示
		WriteOLedCmd(0x00);//---set low column address设置列起始地址低4位
		WriteOLedCmd(0x10);//---set high column address设置列起始地址高4位
		WriteOLedCmd(0x40);//--set start line address  Set Mapping RAM Display Start Line (0x00~0x3F)设置显示开始0-63
		WriteOLedCmd(0x81);//--set contrast control register 对比度
		WriteOLedCmd(0xCF);//--Set SEG Output Current Brightness
		WriteOLedCmd(0xA1);//--Set SEG/Column Mapping(A0h/A1h) 设置Segment重映射
		WriteOLedCmd(0xC8);//--Set COM/Row Scan Direction(C0h/C8h) 设置COM输出扫描方向
		WriteOLedCmd(0xA6);//--set normal display
		WriteOLedCmd(0xA8);//--set multiplex ratio(1 to 64)设置分辨率
		WriteOLedCmd(0x3f);//--128*64个像素大小；0x1f：128*32是0.91寸大小的OLED
		WriteOLedCmd(0xD3);//--set display offset设置显示偏移
		WriteOLedCmd(0x00);//--not offset无偏移
		WriteOLedCmd(0xD5);//--set display clock divide ratio/oscillator frequency设置显示时钟分频率、振荡器频率
		WriteOLedCmd(0x80);//--set divide ratio, Set Clock as 100 Frames/Sec
		WriteOLedCmd(0xD9);//--set pre-charge period设置重充电周期
		WriteOLedCmd(0xF1);//--Set Pre-Charge as 15 Clocks & Discharge as 1 Clock
		WriteOLedCmd(0xDA);//--set com pins hardware configuration设置COM引脚硬件配置
		WriteOLedCmd(0x12);//0.96寸OLEDCOM引脚硬件配置
		WriteOLedCmd(0xDB);//--set vcomh设置Vcomh取消选择水平
		WriteOLedCmd(0x40);//--Set VCOM Deselect Level
		WriteOLedCmd(0x20);//--Set Page Addressing Mode (0x00水平/0x01垂直/0x02页)设置内存地址模式
		WriteOLedCmd(0x02);//页寻址
		WriteOLedCmd(0x8D);//--set Charge Pump enable/disable使能/禁用电荷泵
		WriteOLedCmd(0x14);//--set(0x10) disable
		WriteOLedCmd(0xA4);//--Disable Entire Display On (0xa4/0xa5)全部显示开启
		WriteOLedCmd(0xA6);//--Disable Inverse Display On (0xa6/0xa7)设置正常/反相显示
		WriteOLedCmd(0xAF);//--turn on oled panel开启显示
		
		OLed_Fill(0x00);    //清屏
}

void OLed_Write_chinese(u8 x , u8 y,char* data)
{
	u8 i,j;
	for(i = 0;i < 2; i++)
	{
		OLED_Set_Position(x,y+i);
		for(j = 0;j < 16;j++)
			WriteOLedData(data[j+16*i]);
	}
}

void OLed_Write_String(u8 x , u8 y,char* str)
{
	u8 i,j;
	while(*str)
	{
		for(i = 0;i < 2; i++)
		{
			OLED_Set_Position(x,y+i);
			for(j = 0;i < 8;j++)
				WriteOLedData(F8X16[(*str-32)*16 +j+ 8*i]);
		}
	}
	x+=8; //显示完一个字符加一
	str++;
}
